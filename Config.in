## Config.in
```kconfig
################################################################################
# SPDX-License-Identifier: LGPL-3.0-only
#
# This file is part of Stroll.
# Copyright (C) 2017-2023 Grégor Boirie <gregor.boirie@free.fr>
################################################################################

config STROLL_PROVIDES_LIBS
       bool
       default n

config STROLL_ASSERT
	bool "Assertion"
	select STROLL_PROVIDES_LIBS
	default n
	help
	  Build Stroll library assertion framework exposing a programmatic
	  assertion API for use by client code. See <stroll/assert.h>.

config STROLL_ASSERT_API
	bool "API assertion"
	select STROLL_ASSERT
	default n
	help
	  Build Stroll library with high-level API assertions enabled to ensure
	  that API functions exposed by Stroll will perform full verification of
	  arguments consistency.

config STROLL_ASSERT_INTERN
	bool "Internal assertion"
	select STROLL_ASSERT_API
	default n
	help
	  Build Stroll library with internal assertions enabled to check for
	  internal Stroll behavioral consistency.

config STROLL_UTEST
	bool "Unit tests"
	default n
	help
	  Build Stroll library unit test suite.

config STROLL_VALGRIND
	bool "Valgrind support"
	depends on STROLL_UTEST
	default n
	help
	  Build Stroll library unit test suite with Valgrind support enabled.
	  For debugging purposes only: do not use in production.

config STROLL_PTEST
	bool "Performance tests"
	default n
	help
	  Build Stroll library performance test suite.

config STROLL_BOPS
	bool "Bit operations"
	default y
	help
	  Build Stroll library bit operations framework exposing functions to
	  perform bitwise operations upon words in memory such as:
	  * find first bit set,
	  * find first bit cleared,
	  * find last bit set,
	  * compute hamming weight,
	  * etc...
	  See <stroll/bops.h>.

config STROLL_POW2
	bool "Power of 2 operations"
	default y
	select STROLL_BOPS
	select STROLL_PROVIDES_LIBS
	help
	  Build Stroll library basic power of 2 operations framework exposing
	  functions to find closes lower / upper power of 2 of a word.
	  See <stroll/pow2.h>.

config STROLL_BMAP
	bool "Bitmap"
	default y
	select STROLL_BOPS
	help
	  Build Stroll library with bitmap framework exposing functions to
	  perform usual operations over bitmaps stored into memory words such
	  as:
	  - and / or / xor operations,
	  - test bit / mask / bit range,
	  - hamming weight,
	  - iteration,
	  - etc...
	  See <stroll/bmap.h>.

config STROLL_FBMAP
	bool "Fixed sized bitmap"
	default y
	select STROLL_BOPS
	select STROLL_PROVIDES_LIBS
	help
	  Build Stroll library with a bitmap framework allowing to manipulate
	  bitmaps stored into memory area of arbitrary fixed sizes.
	  Multiple functions are exposed to perform usual operations such as:
	  - test bit / mask / bit range,
	  - hamming weight,
	  - iteration,
	  - etc...
	  See <stroll/fbmap.h>.

config STROLL_LVSTR
	bool "Length-Value String"
	select STROLL_PROVIDES_LIBS
	default y
	help
	  Build Stroll library with length-value string framework meant to ease
	  the life-cycle of C strings.
	  See <stroll/lvstr.h>.

menuconfig STROLL_HEAP
	bool "Heaps"
	select STROLL_PROVIDES_LIBS
	default y

if STROLL_HEAP

config STROLL_FBHEAP
	bool "Binary heap"
	default STROLL_HEAP
	help
	  Document me!

config STROLL_FWHEAP
	bool "Weak heap"
	default n
	help
	  Document me!

config STROLL_HPRHEAP
	bool "Paring heap (half-ordered)"
	default y
	help
	  An implementation of a Pairing Heap based on a half-ordered binary
	  tree structure.
	  The following operations are supported: peek, insert, merge, extract.
	  The pairing heap is a type of self-adjusting binomial heap data
	  structure that has fast amortized performance.
	  See https://en.wikipedia.org/wiki/Pairing_heap

config STROLL_DPRHEAP
	bool "Pairing heap (heap-ordered with parent)"
	select STROLL_DLIST
	default y
	help
	  An implementation of a Pairing Heap based on a heap-ordered multi-way
	  tree structure where each node contains a pointer to its parent. The
	  multi-way tree is implemented using a doubly-linked list based left
	  child right sibling representation.
	  The following operations are supported: peek, insert, merge, extract,
	  remove, promote, demote.
	  The pairing heap is a type of self-adjusting binomial heap data
	  structure that has fast amortized performance.
	  See https://en.wikipedia.org/wiki/Pairing_heap

config STROLL_PPRHEAP
	bool "Paring heap (half-ordered with parent)"
	default y
	help
	  An implementation of a Pairing Heap based on a half-ordered binary
	  tree structure where each node contains a pointer to its parent.
	  The following operations are supported: peek, insert, merge, extract,
	  remove, promote, demote.
	  The pairing heap is a type of self-adjusting binomial heap data
	  structure that has fast amortized performance.
	  See https://en.wikipedia.org/wiki/Pairing_heap

config STROLL_DRPHEAP
	bool "Rank pairing heap (doubly linked half-ordered trees)"
	select STROLL_BOPS
	default n
	help
	  An implementation of a Rank pairing Heap based on a doubly linked list
	  of half-ordered binary trees where each node contains a pointer to its
	  parent.
	  The following operations are supported: peek, insert, merge, extract,
	  remove, promote, demote.
	  The rank pairing heap is a kind of self-adjusting heap data structure
	  that combines the asymptotic efficiency of Fibonacci heaps with much
	  of the simplicity of pairing heaps.
	  See https://www.cs.princeton.edu/courses/archive/spr10/cos423/handouts/rankpairingheaps.pdf

config STROLL_DBNHEAP
	bool "Binomial heap (doubly linked multi-way trees)"
	select STROLL_DLIST
	default n
	help
	  An implementation of a Binomial Heap based on a heap-ordered multi-way
	  tree structure where each node contains a pointer to its parent. The
	  multi-way tree is implemented using a doubly-linked list based left
	  child right sibling representation.
	  The following operations are supported: peek, insert, merge, extract,
	  remove, promote, demote.
	  A binomial heap is a collections of binomial trees linked together
	  where each tree is an ordered heap and allowing for efficient merging
	  of heaps.
	  See https://en.wikipedia.org/wiki/Binomial_heap

endif # STROLL_HEAP

menuconfig STROLL_ARRAY
	bool "Array based algorithms"
	select STROLL_PROVIDES_LIBS
	default y

if STROLL_ARRAY

config STROLL_ARRAY_BISECT_SEARCH
	bool "Bisection / dichotomic search"
	select STROLL_PROVIDES_LIBS
	default y
	help
	  Build Stroll library with support for bisection / dichotomic search
	  within pre-sorted arrays.
	  See <stroll/array.h>.

config STROLL_ARRAY_BUBBLE_SORT
	bool "Bubble sort"
	select STROLL_PROVIDES_LIBS
	default n
	help
	  Build Stroll library with support for the bubble sort algorithm over
	  arrays.
	  See <stroll/array.h>.
	  Implemented for reference only: **DO NOT USE IT**.

config STROLL_ARRAY_SELECT_SORT
	bool "Selection sort"
	select STROLL_PROVIDES_LIBS
	default n
	help
	  Build Stroll library with support for the selection sort algorithm
	  over arrays.
	  See <stroll/array.h>.
	  Implemented for reference only: **DO NOT USE IT**.

config STROLL_ARRAY_INSERT_SORT
	bool "Insertion sort"
	select STROLL_PROVIDES_LIBS
	default y
	help
	  Build Stroll library with support for the insertion sort algorithm
	  over arrays.
	  See <stroll/array.h>.

config STROLL_ARRAY_QUICK_SORT_UTILS
	bool
	select STROLL_PROVIDES_LIBS
	default n

config STROLL_ARRAY_QUICK_SORT
	bool "Quick sort"
	select STROLL_ARRAY_QUICK_SORT_UTILS
	select STROLL_ARRAY_INSERT
	default y
	help
	  Build Stroll library with support for an optimized hybrid version of
	  the quick sort algorithm over arrays.
	  See <stroll/array.h>.

config STROLL_ARRAY_QUICK_SORT_INSERT_THRESHOLD
	int "Quick sort insertion threshold"
	depends on STROLL_ARRAY_QUICK_SORT
	range 2 128
	default 16
	help
	  Threshold that configures the switch of quick sort to insertion sort.
	  For each partition, when the number of elements left to sort is below
	  this threshold, quick sort will switch to insertion sort to minimize
	  the number of element swap operations.

config STROLL_ARRAY_3WQUICK_SORT
	bool "3-way quick sort"
	select STROLL_ARRAY_QUICK_SORT_UTILS
	select STROLL_ARRAY_INSERT
	default y
	help
	  Build Stroll library with support for an optimized hybrid version of
	  the 3-way partition quick sort algorithm over arrays optimized for
	  inputs containing many duplicate elements.
	  See <stroll/array.h>.

config STROLL_ARRAY_3WQUICK_SORT_INSERT_THRESHOLD
	int "3-way quick sort insertion threshold"
	depends on STROLL_ARRAY_3WQUICK_SORT
	range 2 128
	default 8
	help
	  Threshold that configures the switch of 3-way quick sort to insertion
	  sort.
	  For each partition, when the number of elements left to sort is below
	  this threshold, quick sort will switch to insertion sort to minimize
	  the number of element swap operations.

choice
	prompt "3-way quick sort partitioning strategy"
	depends on STROLL_ARRAY_3WQUICK_SORT
	default STROLL_ARRAY_3WQUICK_SORT_BENTLEY_MCILROY
	help
	  Select the default partitioning strategy used for 3-way quick
	  sort algorithm.

config STROLL_ARRAY_3WQUICK_SORT_DIJKSTRA
	bool "Dijkstra"
	depends on STROLL_ARRAY_3WQUICK_SORT
	help
	  Dijkstra's 3-way partitioning logic based upon the
	  "Dutch National Flag" problem. It enhances quick sort performances for
	  inputs where there are small number of distinct values. However, as
	  it exhibits poor locality of references and performs more swaps than
	  necessary, it is not suitable for inputs containing moderate to large
	  number of distinct key values.
	  Prefer Bentley-McIlroy's scheme instead.

config STROLL_ARRAY_3WQUICK_SORT_BENTLEY_MCILROY
	bool "Bentley-McIlroy"
	depends on STROLL_ARRAY_3WQUICK_SORT
	help
	  Bentley-McIlroy's 3-way partitioning logic, also known as
	  "fast partitioning", is an improvement over Dijkstra's scheme
	  since it limits the extra overhead required to process keys equal to
	  pivot.
	  It is a suitable alternative to the standard 2-way partitioning logic
	  when inputs contain a small number of distinct key values.

endchoice

config STROLL_ARRAY_MERGE_SORT
	bool "Merge sort"
	select STROLL_ARRAY_INSERT
	default y
	help
	  Build Stroll library with support for an optimized hybrid version of
	  the merge sort algorithm over arrays.
	  See <stroll/array.h>.

config STROLL_ARRAY_MERGE_SORT_INSERT_THRESHOLD
	int "Merge sort insertion threshold"
	depends on STROLL_ARRAY_MERGE_SORT
	range 2 128
	default 8
	help
	  Threshold that configures the switch of merge sort to insertion sort.
	  For each partition, when the number of elements left to sort is below
	  this threshold, merge sort will switch to insertion sort to minimize
	  the number of element swap operations.

config STROLL_ARRAY_MERGE_SORT_FULL_RUNS
	bool "Merge sort full runs optimization"
	depends on STROLL_ARRAY_MERGE_SORT
	default y
	help
	  This optimization gives merge sort the ability to detect fully ordered
	  partitions in order to skip the usual partitions / sub-arrays merging
	  process at the expense of 2 additional array element comparisons.
	  This may improve performances for partially / fully ordered data sets.

config STROLL_ARRAY_MERGE_SORT_RUNS_BYBLOCK
	bool "Merge sort runs by block optimization"
	depends on STROLL_ARRAY_MERGE_SORT
	default y
	help
	  This optimization gives merge sort the ability to try to merge
	  partitions / sub-arrays by blocks of consecutive ordered elements as
	  opposed to the traditional single element based merging process.
	  This allows to replace multiple primary element copy operations
	  by one single copy of a block of ordered primary elements.
	  This may improve performances for partially / fully ordered data sets.

config STROLL_ARRAY_FBHEAP_SORT
	bool "Binary heap sort"
	default y
	help
	  Document me!

config STROLL_ARRAY_FWHEAP_SORT
	bool "Weak heap sort"
	default y
	help
	  Document me!

endif # STROLL_ARRAY

menuconfig STROLL_LIST
	bool "Linked list based algorithms"
	select STROLL_PROVIDES_LIBS
	default y

if STROLL_LIST

config STROLL_SLIST
	bool "Singly linked list"
	default y
	help
	  Build Stroll library with support for singly linked lists where
	  each node contains a single reference to the next one in the sequence.
	  See <stroll/slist.h>.

config STROLL_SLIST_BUBBLE_SORT
	bool "Bubble sort"
	depends on STROLL_SLIST
	default n
	help
	  Build Stroll library with support for the bubble sort algorithm over
	  singly linked lists.
	  See <stroll/slist.h>.
	  Implemented for reference only: **DO NOT USE IT**.

config STROLL_SLIST_SELECT_SORT
	bool "Selection sort"
	depends on STROLL_SLIST
	default n
	help
	  Build Stroll library with support for the selection sort algorithm
	  over singly linked lists.
	  See <stroll/slist.h>.
	  Implemented for reference only: **DO NOT USE IT**.

config STROLL_SLIST_INSERT_SORT_UTILS
	bool
	depends on STROLL_SLIST
	default n
	help
	  Build Stroll library with support for internal utilities to sort
	  singly linked list according to the insertion sort scheme.

config STROLL_SLIST_INSERT_SORT
	bool "Insertion sort"
	depends on STROLL_SLIST
	select STROLL_SLIST_INSERT_SORT_UTILS
	default y
	help
	  Build Stroll library with support for the insertion sort algorithm
	  over singly linked list.
	  See <stroll/slist.h>.

config STROLL_SLIST_MERGE_SORT
	bool "Merge sort"
	depends on STROLL_SLIST
	select STROLL_SLIST_INSERT_SORT_UTILS
	default y
	help
	  Build Stroll library with support for an optimized hybrid version of
	  the merge sort algorithm over singly linked lists.
	  See <stroll/slist.h>.

config STROLL_SLIST_MERGE_SORT_INSERT_THRESHOLD
	int "Merge sort insertion threshold"
	depends on STROLL_SLIST_MERGE_SORT
	range 2 128
	default 8
	help
	  Threshold that configures the switch of (sub-)lists merge sort to
	  insertion sort to minize the number of merging passes.

config STROLL_SLIST_KWMERGE_SORT
	bool "K-way Merge sort"
	depends on STROLL_SLIST
	select STROLL_SLIST_MERGE_SORT
	default y
	help
	  Build Stroll library with support for an optimized hybrid version of
	  the k-way merge sort algorithm over singly linked lists.
	  See <stroll/slist.h>.

config STROLL_DLIST
	bool "Doubly linked list"
	select STROLL_PROVIDES_LIBS
	default y
	help
	  Build Stroll library with support for doubly linked lists where
	  each node contains 2 references, respectively to previous and next
	  nodes in the sequence.
	  See <stroll/dlist.h>.

config STROLL_DLIST_BUBBLE_SORT
	bool "Bubble sort"
	depends on STROLL_DLIST
	default n
	help
	  Build Stroll library with support for the bubble sort algorithm over
	  doubly linked lists.
	  See <stroll/dlist.h>.
	  Implemented for reference only: **DO NOT USE IT**.

config STROLL_DLIST_SELECT_SORT
	bool "Selection sort"
	depends on STROLL_DLIST
	default n
	help
	  Build Stroll library with support for the selection sort algorithm
	  over doubly linked lists.
	  See <stroll/dlist.h>.
	  Implemented for reference only: **DO NOT USE IT**.

config STROLL_DLIST_INSERT_SORT_UTILS
	bool
	depends on STROLL_DLIST
	default n
	help
	  Build Stroll library with support for internal utilities to sort
	  doubly linked list according to the insertion sort scheme.

config STROLL_DLIST_INSERT_SORT
	bool "Insertion sort"
	depends on STROLL_DLIST
	select STROLL_DLIST_INSERT_SORT_UTILS
	default y
	help
	  Build Stroll library with support for the insertion sort algorithm
	  over doubly linked list.
	  See <stroll/dlist.h>.

config STROLL_DLIST_MERGE_SORT
	bool "Merge sort"
	depends on STROLL_DLIST
	select STROLL_DLIST_INSERT_SORT_UTILS
	default y
	help
	  Build Stroll library with support for an optimized hybrid version of
	  the merge sort algorithm over doubly linked lists.
	  See <stroll/dlist.h>.

config STROLL_DLIST_MERGE_SORT_INSERT_THRESHOLD
	int "Merge sort insertion threshold"
	depends on STROLL_DLIST_MERGE_SORT
	range 2 128
	default 8
	help
	  Threshold that configures the switch of (sub-)lists merge sort to
	  insertion sort to minize the number of merging passes.

config STROLL_DLIST_KWMERGE_SORT
	bool "K-way Merge sort"
	depends on STROLL_DLIST
	select STROLL_DLIST_MERGE_SORT
	default y
	help
	  Build Stroll library with support for an optimized hybrid version of
	  the k-way merge sort algorithm over doubly linked lists.
	  See <stroll/dlist.h>.

endif # STROLL_LIST

config STROLL_ALLOC
	bool
	default n

config STROLL_PALLOC
	bool "Small fixed sized object pre-allocator"
	select STROLL_ALLOC
	select STROLL_POW2
	default y
	help
	  Build Stroll library with support for a primitive allocator allowing
	  to pre-allocate a fixed number of objects of constant size.
	  See <stroll/palloc.h>.

config STROLL_LALLOC
	bool "Large fixed sized objects pre-allocator"
	select STROLL_ALLOC
	select STROLL_POW2
	default y
	help
	  Build Stroll library with support for a primitive allocator allowing
	  to pre-allocate a fixed number of objects of large constant size.
	  See <stroll/lalloc.h>.

config STROLL_FALLOC
	bool "Fixed sized object allocator"
	select STROLL_ALLOC
	select STROLL_DLIST
	select STROLL_POW2
	default y
	help
	  Build Stroll library with support for a simple allocator allowing to
	  allocate a variable number of constant sized objects.
	  See <stroll/falloc.h>.

config STROLL_HLIST
	bool "Hash list"
	default y
	help
	  Build Stroll library with support for doubly linked list geared for
	  hash table bucket implementation purposes.
	  See <stroll/hlist.h>.

config STROLL_HASH
	bool "Content hashing"
	default y
	help
	  Build Stroll library with support for non-cryptographic content
	  hashing. This may be used as a building block to implement hash tables
	  based upon hash lists.
	  See <stroll/hash.h>.

config STROLL_BUFF
	bool "Data buffer"
	default n
	help
	  Build Stroll library with support for data buffer.
	  See <stroll/buffer.h>

config STROLL_BUFF_CAPACITY_MAX
	int "Maximum buffer capacity"
	depends on STROLL_BUFF
	range 8 4294967295
	default 65536
	help
	  Set maximum buffer capacity. MUST be >= 8 and < 4GiB
	  See <stroll/buffer.h>

config STROLL_MSG
	bool "Message iterator"
	default y
	select STROLL_BUFF
	help
	  Build Stroll library with support for message iterator.
	  See <stroll/message.h>

# ex: ft=kconfig:
```
